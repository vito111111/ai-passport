## sdkconfig.defaults
```kconfig
# --- 目标芯片 ---
CONFIG_IDF_TARGET="esp32c3"
# 注:ESP32-C3 无 PSRAM,故不设 CONFIG_SPIRAM。

# --- Flash ---
# 取 8MB:该硬件批次为 W25Q64 (8MB / 64Mb)。
# 注意:镜像头 flash 大小字段需与实际芯片匹配，否则 esp_flash_init 失败。
# verify_firmware.py 要求 flash_args 含 --flash_size 8MB，故此处与之一致。
CONFIG_ESPTOOLPY_FLASHSIZE_8MB=y
# 取消 HEADER_FLASHSIZE_UPDATE:镜像头已含正确大小，无需运行时探测。
# CONFIG_ESPTOOLPY_HEADER_FLASHSIZE_UPDATE=y
CONFIG_PARTITION_TABLE_SINGLE_APP_LARGE=y

# --- 控制台:USB-Serial-JTAG(C3 原生 USB,GPIO18/19)---
# 不用 UART0:其默认 TX=GPIO21 与本板背光引脚冲突。
CONFIG_ESP_CONSOLE_USB_SERIAL_JTAG=y
CONFIG_ESP_CONSOLE_SECONDARY_NONE=y

# --- LVGL ---
CONFIG_LV_COLOR_DEPTH_16=y
CONFIG_LV_FONT_MONTSERRAT_14=y
CONFIG_LV_FONT_MONTSERRAT_20=y
CONFIG_LV_FONT_UNSCII_16=y
CONFIG_LV_FONT_UNSCII_8=y
# LVGL 内置 malloc 池大小(KB)。它是独立静态区、不与系统堆共享,配大了会白白占用 RAM。
# 本 demo UI 简单,24KB 足够;若自建复杂界面出现绘制卡死/看门狗,调大此值。
CONFIG_LV_MEM_SIZE_KILOBYTES=24

# --- 系统 ---
CONFIG_FREERTOS_HZ=1000

# --- Bluetooth LE / NimBLE ---
CONFIG_BT_ENABLED=y
CONFIG_BT_NIMBLE_ENABLED=y
CONFIG_BT_NIMBLE_ROLE_PERIPHERAL=y
CONFIG_BT_NIMBLE_MAX_CONNECTIONS=1
CONFIG_BT_NIMBLE_HOST_BASED_PRIVACY=n
CONFIG_BT_NIMBLE_UTIL_API=y
CONFIG_BT_NIMBLE_SM_LEGACY=n
CONFIG_BT_NIMBLE_SM_SC=y
CONFIG_BT_NIMBLE_SMP_ID_RESET=n
CONFIG_BT_NIMBLE_NVS_PERSIST=y
```
